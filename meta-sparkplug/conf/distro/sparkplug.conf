## meta-sparkplug/conf/distro/sparkplug.conf
```bitbake
DISTRO = "sparkplug"
DISTRO_VERSION = "0.0.1"

DISTRO_NAME = "SparkPlug"
TARGET_VENDOR = "-sparkplug"

TCLIBCAPPEND = ""

DISTRO_FEATURES ?= "${DISTRO_FEATURES_DEFAULT} \
    ipv4 ipv6 alsa bluetooth keyboard usbgadget \
    usbhost wifi opengl wayland pam \
    "

DISTRO_EXTRA_RDEPENDS += "packagegroup-core-boot"
DISTRO_EXTRA_RRECOMMENDS += ""

PREFERRED_VERSION_linux-yocto ?= "6.6%"

PACKAGE_CLASSES ?= "package_rpm"

# Required to build BT/WIFI firmware for Raspberry Pi
LICENSE_FLAGS_ACCEPTED = "synaptics-killswitch"

INIT_MANAGER = "systemd"
```

## meta-sparkplug/conf/layer.conf
```bitbake
# We have a conf and classes directory, add to BBPATH
BBPATH .= ":${LAYERDIR}"

# We have recipes-* directories, add to BBFILES
BBFILES += "${LAYERDIR}/recipes-*/*/*.bb \
            ${LAYERDIR}/recipes-*/*/*.bbappend"

BBFILE_COLLECTIONS += "meta-sparkplug"
BBFILE_PATTERN_meta-sparkplug = "^${LAYERDIR}/"
BBFILE_PRIORITY_meta-sparkplug = "6"

LAYERDEPENDS_meta-sparkplug = "core"
LAYERSERIES_COMPAT_meta-sparkplug = "scarthgap"
```
